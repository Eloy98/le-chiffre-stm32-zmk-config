## boards/arm/le_chiffre_stm32/Kconfig.defconfig
```kconfig
# Le Chiffre (stm32) board configuration

# Copyright (c) 2020 The ZMK Contributors
# SPDX-License-Identifier: MIT

if BOARD_LE_CHIFFRE_STM32

config BOARD
    default "le_chiffre_stm32"

config ZMK_KEYBOARD_NAME
    default "Le Chiffre"

config ZMK_USB
    default y

config ZMK_KSCAN_MATRIX_POLLING
    default y


if ZMK_STUDIO

choice ZMK_BEHAVIOR_LOCAL_ID_TYPE
	default ZMK_BEHAVIOR_LOCAL_ID_TYPE_CRC16
endchoice 

config ZMK_STUDIO_RPC_THREAD_STACK_SIZE
    default 3800

config ZMK_STUDIO_RPC_TX_BUF_SIZE
    default 32

endif

endif # BOARD_LE_CHIFFRE_STM32
```
